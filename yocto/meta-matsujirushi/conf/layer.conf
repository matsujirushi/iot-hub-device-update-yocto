## yocto/meta-matsujirushi/conf/layer.conf
```bitbake
# We have a conf and classes directory, add to BBPATH
BBPATH .= ":${LAYERDIR}"

# We have recipes-* directories, add to BBFILES
BBFILES += "${LAYERDIR}/recipes-*/*/*.bb \
            ${LAYERDIR}/recipes-*/*/*.bbappend"

BBFILE_COLLECTIONS += "meta-matsujirushi"
BBFILE_PATTERN_meta-matsujirushi = "^${LAYERDIR}/"
BBFILE_PRIORITY_meta-matsujirushi = "6"

LAYERDEPENDS_meta-matsujirushi = "core"
LAYERSERIES_COMPAT_meta-matsujirushi = "honister"
```
